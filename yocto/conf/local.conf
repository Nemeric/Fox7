## yocto/conf/local.conf
```bitbake
#
# This file is your local configuration file and is where all local user settings
# are placed. The comments in this file give some guide to the options a new user
# to the system might want to change but pretty much any configuration option can
# be set in this file. More adventurous users can look at local.conf.extended
# which contains other examples of configuration which can be placed in this file
# but new users likely won't need any of them initially.
#
# Lines starting with the '#' character are commented out and in some cases the
# default values are provided as comments to show people example syntax. Enabling
# the option is a question of removing the # character and making any change to the
# variable as required.

LICENSE_FLAGS_WHITELIST = "commercial"

#
# Machine Selection
#
# You need to select a specific machine to target the build with. There are a selection
# of emulated machines available which can boot and run in the QEMU emulator:
#
MACHINE ??= "raspberrypi3"

#
# Where to place downloads
#
DL_DIR ?= "${TOPDIR}/downloads"

#
# Where to place shared-state files
#
SSTATE_DIR ?= "${TOPDIR}/sstate-cache"

#
# Where to place the build output
#
TMPDIR = "${TOPDIR}/tmp"

#
# Default policy config
#
DISTRO ?= "poky"
#PREFERRED_PROVIDER_virtual/kernel ?= "linux-raspberrypi-rt"

#
# Package Management configuration
#
PACKAGE_CLASSES ?= "package_ipk"

#
# SDK target architecture
#
SDKMACHINE ?= "x86_64"

#
# Extra image configuration defaults
#
EXTRA_IMAGE_FEATURES ?= "debug-tweaks"

#
# Additional image features
#
# The following is a list of additional classes to use when building images which
# enable extra features. Some available options which can be included in this variable
# are:
#   - 'buildstats' collect build statistics
#   - 'image-mklibs' to reduce shared library files size for an image
#   - 'image-prelink' in order to prelink the filesystem image
# NOTE: if listing mklibs & prelink both, then make sure mklibs is before prelink
# NOTE: mklibs also needs to be explicitly enabled for a given image, see local.conf.extended
USER_CLASSES ?= "buildstats image-mklibs image-prelink"

#
# Runtime testing of images
#
#IMAGE_CLASSES += "testimage testsdk"
#TESTIMAGE_AUTO_qemuall = "1"

#
# Interactive shell configuration
#
#OE_TERMINAL = "auto"
# By default disable interactive patch resolution (tasks will just fail instead):
PATCHRESOLVE = "noop"

#
# Disk Space Monitoring during the build
#
# Monitor the disk space during the build. If there is less that 1GB of space or less
# than 100K inodes in any key build location (TMPDIR, DL_DIR, SSTATE_DIR), gracefully
# shutdown the build. If there is less that 100MB or 1K inodes, perform a hard abort
# of the build. The reason for this is that running completely out of space can corrupt
# files and damages the build in ways which may not be easily recoverable.
# It's necesary to monitor /tmp, if there is no space left the build will fail
# with very exotic errors.
BB_DISKMON_DIRS ??= "\
    STOPTASKS,${TMPDIR},1G,100K \
    STOPTASKS,${DL_DIR},1G,100K \
    STOPTASKS,${SSTATE_DIR},1G,100K \
    STOPTASKS,/tmp,100M,100K \
    ABORT,${TMPDIR},100M,1K \
    ABORT,${DL_DIR},100M,1K \
    ABORT,${SSTATE_DIR},100M,1K \
    ABORT,/tmp,10M,1K"

#
# Shared-state files from other locations
#
#SSTATE_MIRRORS ?= "\
#file://.* http://someserver.tld/share/sstate/PATH;downloadfilename=PATH \n \
#file://.* file:///some/local/dir/sstate/PATH"

#
# Yocto Project SState Mirror
#
#SSTATE_MIRRORS ?= "file://.* http://sstate.yoctoproject.org/2.5/PATH;downloadfilename=PATH"

RM_OLD_IMAGE = "1"

# CONF_VERSION is increased each time build/conf/ changes incompatibly and is used to
# track the version of this file when it was generated. This can safely be ignored if
# this doesn't mean anything to you.
CONF_VERSION = "1"
```

## yocto/meta-7robian/conf/distro/foxos.conf
```bitbake
require conf/distro/poky.conf

DISTRO = "foxos"
DISTRO_NAME = "Fox7 Distribution"
DISTRO_VERSION = "1.0-${DATE}"
DISTRO_CODENAME = "foxos"
DISTRO_FEATURES_append = " wifi systemd"
SDK_VENDOR = "-foxos-sdk"
SDK_VERSION = "${DISTRO_VERSION}"
MAINTAINER = "Thomas Chamelot <chamelot.thomas@gmail.com>"

# Enable buildhistory
INHERIT += "buildhistory"
BUILDHISTORY_COMMIT = "1" 

# Enable systemd
VIRTUAL-RUNTIME_init_manager = "systemd"
DISTRO_FEATURES_append = " systemd"
DISTRO_FEATURES_BACKFILL_CONSIDERED = "sysvinit"
VIRTUAL-RUNTIME_initscripts = ""

# Set U-boot as bootloader
KERNEL_IMAGETYPE = "uImage"
IMAGE_DEPENDS_sdimg += " bcm2835-bootfiles"
IMAGE_BOOT_FILES_append = " boot.scr u-boot.bin;${SDIMG_KERNELIMAGE}"
IMAGE_INSTALL_append = " kernel-image kernel-devicetree"

# Add some packages and features
IMAGE_FEATURES_append = " ssh-server-openssh "
IMAGE_INSTALL_append = " i2c-tools "
```

## yocto/meta-7robian/conf/layer.conf
```bitbake
# We have a conf and classes directory, add to BBPATH
BBPATH .= ":${LAYERDIR}"

# We have recipes-* directories, add to BBFILES
BBFILES += "${LAYERDIR}/recipes-*/*/*.bb \
            ${LAYERDIR}/recipes-*/*/*.bbappend \
            ${LAYERDIR}/images*/*.bb"

BBFILE_COLLECTIONS += "meta-7robian"
BBFILE_PATTERN_meta-7robian = "^${LAYERDIR}/"
BBFILE_PRIORITY_meta-7robian = "6"

LAYERDEPENDS_meta-7robian = "core"
LAYERSERIES_COMPAT_meta-7robian = "thud"
```
